## boards/shields/split222EC/Kconfig.defconfig
```kconfig
if SHIELD_SPLIT222EC_LEFT #ここを変えてセントラル側に問題のコードを移行

# Name must be less than 16 characters long!
config ZMK_KEYBOARD_NAME
    default "split222EC"

config ZMK_SPLIT_ROLE_CENTRAL
    default y

endif

if SHIELD_SPLIT222EC_LEFT || SHIELD_SPLIT222EC_RIGHT

config ZMK_SPLIT
    default y


endif
```

## boards/shields/split222EC/Kconfig.shield
```kconfig
#No whitespace after the comma or in your part name!
config SHIELD_SPLIT222EC_LEFT
	def_bool $(shields_list_contains,split222EC_left)

config SHIELD_SPLIT222EC_RIGHT
	def_bool $(shields_list_contains,split222EC_right)
```
