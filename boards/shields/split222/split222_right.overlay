#include "split222.dtsi"
//#include <dt-bindings/zmk/input_transform.h>


// matrix transformでのピン数オフセット
&default_transform { // Offset of 2 because the left side has 2 columns
    col-offset = <2>;
};

// kscan
&kscan0 {
    col-gpios = 
        <&xiao_d 0 GPIO_ACTIVE_HIGH>,
        <&xiao_d 2 GPIO_ACTIVE_HIGH>;

};
